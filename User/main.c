/******************************************************************************
 * 文件名: main.c
 * 描  述: 主程序入口文件
 * 说  明: 系统初始化、主循环任务调度
 *         负责硬件初始化、开机画面、主循环命令/界面/避障/MQTT调度
 *         DHT11每约2秒读取，MQTT每约1秒上报，心跳约30秒发送
 ******************************************************************************/
#include "stm32f10x.h"
#include <led.h>
#include <delay.h>
#include <key.h>
#include <sys.h>
#include <beep.h>
#include <usart.h>
#include <stdio.h>
#include <motor.h>
#include <dht11.h>
#include <avoid.h>
#include <servo.h>
#include <sr04.h>
#include <spatial.h>
#include <ui.h>
#include "esp8266.h"
#include "esp8266_mqtt.h"
#include <follow.h>
#include <snake.h>
#include <wificfg.h>
#include <debug.h>


/******************************************************************************
 * 全局变量
 ******************************************************************************/

/**
 * @brief 通用格式缓冲区，用于sprintf格式化字符串
 *        在parse_cmd和各功能模块中使用
 */
char buf[64];

/**
 * @brief 串口发送缓冲区，用于构建要发送的字符串
 *        主要存放DHT11温湿度格式化的输出文本
 *        每次发送前清零重填
 */
char txbuf[64];

/**
 * @brief DHT11温湿度传感器原始数据缓冲区
 *        buffer[0] = 湿度整数部分
 *        buffer[1] = 湿度小数部分
 *        buffer[2] = 温度整数部分
 *        buffer[3] = 温度小数部分
 *        buffer[4] = 校验和
 */
uint8_t buffer[5];

/**
 * @brief 超声波测距距离值（单位：cm）
 *        distance    - 正前方距离（用于避障决策）
 *        distance_L  - 左侧距离（用于转向判断）
 *        distance_R  - 右侧距离（用于转向判断）
 *        在避障模块（avoid.c）中更新和使用
 */
float distance, distance_L, distance_R;

/* Mode_Avoid 避障模式函数已迁移到 avoid.c 中实现 */

/**
 * @brief 电机当前速度值（外部变量，引自motor模块）
 *        用于调试和状态显示
 */
extern volatile u16 speed;


/******************************************************************************
 * 工作模式定义（引自 usart.h）
 *
 * MODE_REMOTE = 0 : 蓝牙遥控模式（手机通过蓝牙发送指令控制小车）
 * MODE_AUTO   = 1 : 自动避障模式（小车自主运行，红外+超声波避障）
 * MODE_FOLLOW = 2 : 跟随模式（小车跟随前方物体移动）
 *
 * work_mode   : 当前工作模式，可在菜单中切换
 * uart_buf[]  : 串口命令接收缓冲区（包括蓝牙和MQTT下行命令中转）
 * uart_cnt    : 串口命令缓冲区中有效数据长度
 * uart_flag   : 串口命令待处理标志（0=空闲，1=有未处理的命令）
 ******************************************************************************/


/******************************************************************************
 * 函数: main
 * 描述: 系统主入口
 * 说明: 硬件初始化顺序 — GPIO/时钟/中断 -> 传感器/电机 -> 串口 -> MQTT
 *       主循环调度顺序 — DHT11读取 -> MQTT上报 -> 心跳 -> 命令解析 ->
 *                         WiFi配置任务 -> 调试任务 -> UI/贪吃蛇 -> 避障/跟随
 * 参数: 无
 * 返回: 无（嵌入式程序，永不返回）
 ******************************************************************************/
int main(void)
{
    /**************************************************************************
     * 第一阶段：硬件初始化
     * 顺序要求：先初始化基础外设(GPIO/时钟/中断)，再初始化功能模块
     **************************************************************************/

    /* 初始化LED指示灯GPIO（PB12~PB15，用于指示系统运行状态） */
    led_init();

    /* 初始化SysTick定时器（提供毫秒级delay_ms延时） */
    delay_init();

    /* 配置嵌套向量中断控制器（NVIC分组及优先级） */
    NVIC_Configuration();

    /* 初始化蜂鸣器GPIO（用于操作提示音和报警） */
    beep_init();

    /* 初始化红外避障传感器GPIO（PF5~PF8，上拉输入模式） */
    IR_Init();

    /* 初始化超声波测距模块HC-SR04（Trig+Echo GPIO及定时器） */
    SR04_Init();

    /* 初始化OLED用户界面（SSD1306 I2C驱动，含开机画面5秒） */
    UI_Init();

    /* 初始化电机驱动GPIO和PWM定时器（TB6612双路电机驱动） */
    Motor_Init();

    /* 初始化舵机GPIO和PWM（SG90，用于超声波传感器转向扫描） */
    Servo_Init();

    /* 初始化按键外部中断（WK_UP/KEY0/KEY1，跳线帽使能中断触发） */
    KEY_EXTI_Init();

    /* 初始化USART1串口（9600波特率，蓝牙HC-05模块通信） */
    USART1_Init(9600);

    /* 初始化USART2串口（115200波特率，调试串口输出） */
    USART2_Init(115200);

    /* 初始化USART3串口（115200波特率，ESP8266 WiFi模块通信） */
    USART3_Init(115200);

    /**************************************************************************
     * 第二阶段：WiFi + MQTT 连接初始化
     * esp8266_mqtt_init_animated() 执行完整的WiFi连接和MQTT建连流程：
     *   1. 退出透传 -> 复位ESP8266 -> 关闭AT回显
     *   2. 检测是否已连接WiFi（AT+CIFSR检查STAIP），未连则连AP
     *   3. TCP连接华为云MQTT Broker（端口1883）
     *   4. 进入透传模式
     *   5. MQTT CONNECT（使用华为云设备凭证）
     *   6. 订阅消息下行和命令下发Topic
     *   整个过程OLED播放WiFi连接动画
     **************************************************************************/
    esp8266_mqtt_init_animated();

    /* 串口输出系统启动信息 */
    printf("hello\r\n");                            /* USART1 打印（蓝牙串口） */
    USART2_SendString("USART2 Init Success!\r\n"); /* USART2 打印（调试串口） */

    /* 开启全局中断（必须在所有外设初始化完成后使能） */
    __enable_irq();

    /**************************************************************************
     * 第三阶段：主循环（无限循环）
     * 每个循环周期约100ms（20ms + 80ms延时）
     * 各功能模块按固定周期调度执行
     **************************************************************************/
    while (1)
    {

        /* ================================================================ */
        /* 模块1：DHT11温湿度读取（约每2秒执行一次）                          */
        /* dht_tmr 每次循环+1，约100ms/次，>=15时触发（即约1.5秒~2秒）       */
        /* ================================================================ */
        {
            static uint16_t dht_tmr = 0;   /* 温湿度定时器，静态局部变量保持计数值 */
            dht_tmr++;
            if (dht_tmr >= 15)             /* 约1.5~2秒触发一次 */
            {
                dht_tmr = 0;               /* 复位定时器 */

                /* 读取DHT11温湿度数据，存入buffer数组 */
                DHT_ReadData(buffer);
                delay_ms(20);              /* 等待数据稳定 */

                /* 格式化温湿度数据为可读字符串 */
                sprintf(txbuf, "Tmp:%d.%dC,Humi:%d.%d%%RH\r\n",
                    (u8)buffer[2], (u8)buffer[3],   /* 温度整数+小数 */
                    (u8)buffer[0], (u8)buffer[1]);   /* 湿度整数+小数 */

                /* 通过USART2（调试串口）输出温湿度信息 */
                USART2_SendString(txbuf);

                /* 通过USART1（蓝牙串口）输出温湿度信息 */
                USART1_SendString(txbuf);

                /* 更新OLED屏幕上的温湿度显示 */
                UI_UpdateTH((u8)buffer[2], (u8)buffer[3],   /* 温度 */
                           (u8)buffer[0], (u8)buffer[1]);    /* 湿度 */
            }
        }

        /* 清空txbuf缓冲区，为下次使用做准备 */
        memset((char *)txbuf, 0, sizeof(txbuf));

        /* ================================================================ */
        /* 模块2：MQTT温湿度上报（约每1秒执行一次）                            */
        /* mqtt_tmr >= 10 触发上报（10 * 约100ms = 1秒）                    */
        /* 上报JSON数据到华为云IoT平台                                     */
        /* ================================================================ */
        {
            static uint16_t mqtt_tmr = 0;  /* MQTT上报定时器 */
            mqtt_tmr++;
            if (mqtt_tmr >= 10) {          /* 约1秒触发 */
                mqtt_tmr = 0;
                mqtt_report_devices_status();  /* 调用MQTT设备状态上报 */
            }
        }

        /* ================================================================ */
        /* 模块3：MQTT心跳包（约每30秒执行一次）                              */
        /* heart_tmr >= 300 触发（300 * 约100ms = 30秒）                    */
        /* 华为云MQTT心跳保活间隔建议为KeepAlive的1/2（KeepAlive=60s）      */
        /* ================================================================ */
        {
            static uint16_t heart_tmr = 0; /* 心跳定时器 */
            heart_tmr++;
            if (heart_tmr >= 300) {        /* 约30秒触发 */
                heart_tmr = 0;
                mqtt_send_heart();         /* 发送PINGREQ心跳包 */
            }
        }

        /* 主循环基础延时约20ms（给各任务提供时间片基准） */
        delay_ms(20);

        /* ================================================================ */
        /* 模块4：串口命令解析                                              */
        /* 解析来自蓝牙（USART1）或MQTT下行（mqtt_process_*中转）的命令     */
        /* 支持的命令：前/后/左/右/停/跟随/避障/速度调节等                 */
        /* ================================================================ */
        parse_cmd();

        /* ================================================================ */
        /* 模块5：WiFi配置任务                                              */
        /* 处理手机通过串口发送的WiFi配置指令（SSID/密码修改）              */
        /* ================================================================ */
        WifiCfg_Task();

        /* ================================================================ */
        /* 模块6：调试任务                                                  */
        /* 输出系统状态信息（工作模式/速度/距离/温湿度等）到调试串口        */
        /* ================================================================ */
        Debug_Task();

        /* ================================================================ */
        /* 模块7：贪吃蛇游戏 / 用户界面                                     */
        /* 如果贪吃蛇游戏处于激活状态，运行游戏任务；否则运行正常UI任务      */
        /* Snake_IsActive() 返回 true 表示游戏正在运行                      */
        /* ================================================================ */
        if (Snake_IsActive()) {
            Snake_Task();    /* 贪吃蛇游戏逻辑和OLED渲染 */
        } else {
            UI_Task();       /* 正常UI界面刷新（表情/温湿度/状态栏） */
        }

        /* ================================================================ */
        /* 模块8：自动避障 / 跟随模式                                      */
        /* 根据当前工作模式（work_mode）执行对应的自主控制逻辑               */
        /* MODE_AUTO   = 1 : 自动避障模式                                   */
        /*    红外防撞优先 -> 超声波空间扫描(9扇区) -> 试探转向 -> 掉头     */
        /* MODE_FOLLOW = 2 : 跟随模式                                       */
        /*    通过超声波测距，保持与前方物体的固定距离进行跟随               */
        /* MODE_REMOTE = 0 : 蓝牙遥控模式（不进入此分支，由parse_cmd控制） */
        /* ================================================================ */
        if (work_mode == MODE_AUTO) {
            Mode_Avoid();            /* 自动避障模式状态机 */
        } else if (work_mode == MODE_FOLLOW) {
            Follow_Task();           /* 跟随模式任务 */
        }

        /* 主循环附加延时约80ms（与前面的20ms合计约100ms一个循环周期） */
        delay_ms(80);
    }
}
